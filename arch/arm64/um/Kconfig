## arch/arm64/um/Kconfig
```kconfig
# SPDX-License-Identifier: GPL-2.0

menu "Host processor type and features (arm64)"
endmenu

config UML_ARM64
	def_bool y
	select GENERIC_HWEIGHT

config 64BIT
	def_bool y
```
